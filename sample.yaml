## sample.yaml
```yaml
sample:
  description: Safety band GNSS
  name: Safety band GNSS
  
common: 
    sysbuild: true
    build_only: true
    integration_platforms: 
      - nrf9151dk/nrf9151/ns
      - nrf9161dk/nrf9161/ns
      - nrf9160dk/nrf9160/ns
      - thingy91x/nrf9151/ns
      - thingy91/nrf9160/ns
    platform_exclude:
      - native_sim
    
tests:
  cell_fund.l6.e1_sol: {}
```
